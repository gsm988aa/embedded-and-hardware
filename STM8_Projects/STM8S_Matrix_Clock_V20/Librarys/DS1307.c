/*******************************************************************************
                             Revision History
********************************************************************************
15.0: Initial version 
*******************************************************************************/
#include "I2C.h"
#include "DS1307.h"
/******************************************************************************/
const uint8_t ALdauthangDL[22][12] = {
    {17,18,16,27,18,19,20,21,23,24,25,26},//2010
    {27,29,27,28,29,30, 1, 2, 4, 5, 6, 7},//2011
    { 8,10, 9,11,11,12,13,14,16,16,18,18},//2012
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    {28,29,28,29,29, 1, 1, 3, 4, 5, 6, 7} //2030
};
/******************************************************************************/
const uint8_t thangALdauthangDL[22][12] = {
    {11,12, 1, 2, 3, 4, 5, 6, 7, 8, 9,10},//2010
    {11,12, 1, 2, 3, 4, 6, 7, 8, 9,10,11},//2011
    {12, 1, 2, 3, 4, 4, 5, 6, 7, 8, 9,10},//2012
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    {11,12, 1, 2, 3, 5, 6, 7, 8, 9,10,11} //2030
};
/******************************************************************************/
const uint8_t DLdauthangAL[22][12] = {
    {15,14,16, 5,14,12,12,10, 8, 8, 6, 6},//2010
    { 4, 3, 5, 3, 3, 2,31,29,27,27,25,25},//2011
    {23,22,22,21,21,19,19,17,16,15,14,13},//2012
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    { 4, 2, 4,31, 2,30,30,29,27,27,25,25} //2030
};
/******************************************************************************/
const uint8_t thangALdauthangAL[22][12] = {
    {12, 1, 2, 3, 4, 5, 6, 7, 8, 9,10,11},//2010
    {12, 1, 2, 3, 4, 5, 7, 8, 9,10,11,12},//2011
    { 1, 2, 3, 4, 4, 5, 6, 7, 8, 9,10,11},//2012
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    {12, 1, 2, 3, 4, 5, 7, 8, 9,10,11,12} //2030
};
/*******************************************************************************
                         void RTC_Init(void)
*******************************************************************************/
void RTC_Init(void)
{
    I2C_Init();
    I2C_Start();                       /* Start I2C */
    I2C_WriteByte(DS1307_WRITE_MODE);  /* Set write mode to DS1307 */
    I2C_WriteByte(DS1307_CONTROL_REG); /* Select control register */
    I2C_WriteByte(0x10);               /* Write 0x10 to enable SQW-Out */
    I2C_Stop();                        /* Stop I2C */
}
/*******************************************************************************
                  void DS1307_Write(uint8_t addr, uint8_t dat)
*******************************************************************************/
void DS1307_Write(uint8_t addr, uint8_t dat)
{
    uint8_t temp;
    temp = dat ;
    dat = (((dat/10)*16)|(temp %10));
    I2C_Start();
    I2C_WriteByte(DS1307_WRITE_MODE);
    I2C_WriteByte(addr);
    I2C_WriteByte(dat); 
    I2C_Stop();
}
/*******************************************************************************
                    uint8_t DS1307_Read(uint8_t addr)
*******************************************************************************/
uint8_t DS1307_Read(uint8_t addr)
{
    uint8_t tm, ret;
    I2C_Start();
    I2C_WriteByte(DS1307_WRITE_MODE);
    I2C_WriteByte(addr);
    I2C_Start();
    I2C_WriteByte(DS1307_READ_MODE);
    ret = I2C_ReadByte();
    I2C_Stop();
    tm = ret; /*BCD to HEX*/
    ret = (((ret/16)*10)+ (tm & 0x0f));
    return ret;
}
/*******************************************************************************
                    void RTC_SetDateTime(rtc_t *rtc)             
*******************************************************************************/
void RTC_SetDateTime(rtc_t *rtc)
{
    DS1307_Write(DS1307_SEC_REG, rtc->sec);
    DS1307_Write(DS1307_MIN_REG, rtc->min);
    DS1307_Write(DS1307_HOUR_REG, rtc->hour);
    DS1307_Write(DS1307_WEEKDAY_REG, rtc->weekDay);
    DS1307_Write(DS1307_DATE_REG, rtc->date);
    DS1307_Write(DS1307_MONTH_REG, rtc->month);
    DS1307_Write(DS1307_YEAR_REG, rtc->year);
}
/*******************************************************************************
                     void RTC_GetDateTime(rtc_t *rtc)             
*******************************************************************************/
void RTC_GetDateTime(rtc_t *rtc)
{
    rtc->sec = DS1307_Read(DS1307_SEC_REG);
    rtc->min = DS1307_Read(DS1307_MIN_REG);
    rtc->hour = DS1307_Read(DS1307_HOUR_REG);
    rtc->weekDay = DS1307_Read(DS1307_WEEKDAY_REG);
    rtc->date = DS1307_Read(DS1307_DATE_REG);
    rtc->month = DS1307_Read(DS1307_MONTH_REG);
    rtc->year = DS1307_Read(DS1307_YEAR_REG);
}
/*******************************************************************************
        uint32_t RTC_Lunar_Calculate(uint8_t x, uint8_t y, uint8_t t)             
*******************************************************************************/
uint32_t RTC_Lunar_Calculate(rtc_t *rtc) 
{
    uint8_t timeRTC_Mday, timeRTC_Mon, timeRTC_Year, luu, tam_1;
    uint8_t RTCLunarRTC_Mday, RTCLunarRTC_Mon, RTCLunarRTC_Year;
    uint8_t da, db, day_1, mon_1, year_1;
    uint8_t lmon;
    uint32_t luu_amlich=0;
    timeRTC_Mday = rtc->date;
    timeRTC_Mon = rtc->month;
    timeRTC_Year = rtc->year;
    day_1 = timeRTC_Mday;
    mon_1 = timeRTC_Mon;
    year_1 = timeRTC_Year;
    if ((year_1 - 10) > 30) //cho phep den nam 2030
    {
        goto thoat;
    }
    da = ALdauthangDL[year_1 - 10][mon_1 - 1];
    db = DLdauthangAL[year_1 - 10][mon_1 - 1];
    luu = db - day_1;
    if ((luu) <= 0) 
    {
        RTCLunarRTC_Mday = (day_1 - db + 1);
        RTCLunarRTC_Mon = thangALdauthangAL[year_1 - 10][mon_1 - 1];
    } 
    else 
    {
        if ((luu) > 31) 
        {
            RTCLunarRTC_Mday = (day_1 - db + 1);
            RTCLunarRTC_Mon = thangALdauthangDL[year_1 - 10][mon_1];
        } 
        else 
        {
            RTCLunarRTC_Mday = (day_1 + da - 1);
            RTCLunarRTC_Mon = thangALdauthangDL[year_1 - 10][mon_1 - 1];
        }
    }
    lmon = RTCLunarRTC_Mon;
    tam_1 = mon_1 - lmon;
    if ((tam_1) > 100 && tam_1 < 255)RTCLunarRTC_Year = (year_1 - 1);
    else 
    {
        RTCLunarRTC_Year = year_1;
    }
    luu_amlich = luu_amlich | RTCLunarRTC_Year;
    luu_amlich <<= 8;
    luu_amlich = luu_amlich | RTCLunarRTC_Mon;
    luu_amlich <<= 8;
    luu_amlich = luu_amlich | RTCLunarRTC_Mday;
    luu_amlich <<= 8;
    thoat:
      return luu_amlich;
}
/*******************************************************************************
***************************** END OF FILE **************************************
*******************************************************************************/